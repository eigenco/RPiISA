#include <sys/time.h>
#include <fcntl.h>
#include <stdio.h>
#include <stdlib.h>
#include <unistd.h>
#include <sys/mman.h>
#include "isa.h"

void init_vga(void) {
  // ET4000: set key
  outb(0x3bf, 3);
  outb(0x3d8, 0xa0);
  //usleep(100000);

  // ET4000: set clocks
  outb(0x3c4, 0x07);
  outb(0x3c5, 0xfc);
  //usleep(100000);

  // MISC register at port 3c2
  outb(0x3c2, 0x63);

  // ATC registers at port 3c0
  for(int i=0; i<0x10; i++) {
    inb(0x3da);
    outb(0x3c0, i);
    outb(0x3c0, i);
  }
  outb(0x3c0, 0x30); outb(0x3c0, 0x41);
  outb(0x3c0, 0x31); outb(0x3c0, 0x00);
  outb(0x3c0, 0x32); outb(0x3c0, 0x0f);
  outb(0x3c0, 0x33); outb(0x3c0, 0x00);
  outb(0x3c0, 0x34); outb(0x3c0, 0x00);

  // SEQ registers at port 3c4
  outb(0x3c4, 0x00); outb(0x3c5, 0x03);
  outb(0x3c4, 0x01); outb(0x3c5, 0x01);
  outb(0x3c4, 0x02); outb(0x3c5, 0x0f);
  outb(0x3c4, 0x03); outb(0x3c5, 0x00);
  outb(0x3c4, 0x04); outb(0x3c5, 0x0e);

  // GDC registers at port 3ce
  outb(0x3ce, 0x00); outb(0x3cf, 0x00);
  outb(0x3ce, 0x01); outb(0x3cf, 0x00);
  outb(0x3ce, 0x02); outb(0x3cf, 0x00);
  outb(0x3ce, 0x03); outb(0x3cf, 0x00);
  outb(0x3ce, 0x04); outb(0x3cf, 0x00);
  outb(0x3ce, 0x05); outb(0x3cf, 0x40);
  outb(0x3ce, 0x06); outb(0x3cf, 0x05);
  outb(0x3ce, 0x07); outb(0x3cf, 0x0f);
  outb(0x3ce, 0x08); outb(0x3cf, 0xff);

  // CRTC registers at port 3d4
  outb(0x3d4, 0x11); outb(0x3d5, 0x00);
  outb(0x3d4, 0x00); outb(0x3d5, 0x5f);
  outb(0x3d4, 0x01); outb(0x3d5, 0x4f);
  outb(0x3d4, 0x02); outb(0x3d5, 0x50);
  outb(0x3d4, 0x03); outb(0x3d5, 0x82);
  outb(0x3d4, 0x04); outb(0x3d5, 0x54);
  outb(0x3d4, 0x05); outb(0x3d5, 0x80);
  outb(0x3d4, 0x06); outb(0x3d5, 0xbf);
  outb(0x3d4, 0x07); outb(0x3d5, 0x1f);
  outb(0x3d4, 0x08); outb(0x3d5, 0x00);
  outb(0x3d4, 0x09); outb(0x3d5, 0x41);
  outb(0x3d4, 0x0a); outb(0x3d5, 0x00);
  outb(0x3d4, 0x0b); outb(0x3d5, 0x00);
  outb(0x3d4, 0x0c); outb(0x3d5, 0x00);
  outb(0x3d4, 0x0d); outb(0x3d5, 0x00);
  outb(0x3d4, 0x0e); outb(0x3d5, 0x00);
  outb(0x3d4, 0x0f); outb(0x3d5, 0x00);
  outb(0x3d4, 0x10); outb(0x3d5, 0x9c);
  outb(0x3d4, 0x11); outb(0x3d5, 0x8e);
  outb(0x3d4, 0x12); outb(0x3d5, 0x8f);
  outb(0x3d4, 0x13); outb(0x3d5, 0x28);
  outb(0x3d4, 0x14); outb(0x3d5, 0x40);
  outb(0x3d4, 0x15); outb(0x3d5, 0x96);
  outb(0x3d4, 0x16); outb(0x3d5, 0xb9);
  outb(0x3d4, 0x17); outb(0x3d5, 0xa3);
  outb(0x3d4, 0x18); outb(0x3d5, 0xff);

  /* Enable video */
  outb(0x3c0, 0x20);
  //printf("%d\n", inb(0x3da));

  /* Set palette */
  outb(0x3c6, 0xff); // PEL mask
  outb(0x3c8, 0);    // Palette register
  for(int i=0; i<64; i++) {
    outb(0x3c9, i & 63);
    outb(0x3c9, 0);
    outb(0x3c9, 0);
  }
  for(int i=0; i<64; i++) {
    outb(0x3c9, 0);
    outb(0x3c9, i & 63);
    outb(0x3c9, 0);
  }
  for(int i=0; i<64; i++) {
    outb(0x3c9, 0);
    outb(0x3c9, 0);
    outb(0x3c9, i & 63);
  }
  for(int i=0; i<64; i++) {
    outb(0x3c9, i & 63);
    outb(0x3c9, i & 63);
    outb(0x3c9, i & 63);
  }
}

int main() {
  int i, j, k, x, y, z;

  gpio = (unsigned int*)mmap(0, 4096, PROT_READ|PROT_WRITE, MAP_SHARED, open("/dev/gpiomem", O_RDWR|O_SYNC), 0);
  setoutput();
  gpio[GPCLR0] = 0x0FFFFFFF;

  digitalWrite(IOW, 1);
  digitalWrite(IOR, 1);
  digitalWrite(MEMW, 1);
  digitalWrite(MEMR, 1);
  digitalWrite(RESET, 1); updatePins(); usleep(200000);
  digitalWrite(RESET, 0); updatePins(); usleep(300000);
  for(i=0; i<256; i++) memw(0xA0000+i, i);
  init_vga();

  for(y=100; y<200; y++)
    for(x=0; x<320; x++)
      memw(0xA0000 + x + y*320, (x & 63) + 64*((y >> 3)& 3));

  struct timeval t0, t1;
  gettimeofday(&t0, NULL);
  for(z=0; z<200; z++) {
    for(y=0; y<100; y++)
      for(x=0; x<320; x++)
        memw(0xA0000 + x + y*320, rand()&255);
  }
  gettimeofday(&t1, NULL);
  printf("%fe6 bytes/second\n", 200.0*32000.0/(1000000 * t1.tv_sec + t1.tv_usec - 1000000 * t0.tv_sec - t0.tv_usec));
//  printf("%d\n", wcnt);
/*
  for(;;) {
    outb(0x3c8, 0);
    for(int i=0; i<256; i++) {
      outb(0x3c9, rand()&63);
      outb(0x3c9, rand()&63);
      outb(0x3c9, rand()&63);
    }
    usleep(100000);
  }
*/

  return 0;
}
